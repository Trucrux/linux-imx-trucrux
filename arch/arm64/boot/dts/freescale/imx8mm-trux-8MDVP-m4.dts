// SPDX-License-Identifier: (GPL-2.0+ OR MIT)
/*
 * Copyright 2019 NXP
 * Copyright Trucrux.
 */

#include "imx8mm-trux-8MDVP.dts"
#include "imx8mm-trux-8MDVP-m4.dtsi"

/ {
	model = "Trucrux TRUX-MX8M-MINI M4 on 8MDVP 2.x";
};
