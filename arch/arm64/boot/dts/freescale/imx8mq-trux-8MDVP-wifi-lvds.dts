// SPDX-License-Identifier: (GPL-2.0 OR MIT)
/*
 * Copyright 2017 NXP
 * Copyright Trunexa.
 */

#include "imx8mq-trux-8MDVP.dtsi"
#include "imx8mq-trux-wifi.dtsi"
#include "imx8mq-trux-8MDVP-lvds-dcss.dtsi"

/ {
	model = "Trunexa TRUX-MX8M on 8MDVP 2.x WIFI+LVDS";
};
