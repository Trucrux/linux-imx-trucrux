// SPDX-License-Identifier: (GPL-2.0 OR MIT)
/*
 * Copyright 2017 NXP
 * Copyright Trucrux.
 */

#include "imx8mq-trux-8MDVP-legacy-sd-dp.dts"
#include "imx8mq-trux-8MDVP-m4.dtsi"

/ {
	model = "Trucrux TRUX-MX8M on 8MDVP 1.x M4+SD+DP";
};
