// SPDX-License-Identifier: (GPL-2.0 OR MIT)
/*
 * Copyright 2017 NXP
 * Copyright Trucrux.
 */

#include "imx8mq-trux-8MDVP.dtsi"
#include "imx8mq-trux-8MDVP-sd.dtsi"
#include "imx8mq-trux-8MDVP-hdmi.dtsi"

/ {
	model = "Trucrux TRUX-MX8M on 8MDVP 2.x SD+HDMI";
};
